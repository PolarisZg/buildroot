## configs/qemu_mac80211_hwsim_demo_defconfig
```kconfig
# Architecture
BR2_x86_64=y

# System
BR2_SYSTEM_DHCP="eth0"

# Filesystem
BR2_TARGET_ROOTFS_EXT2=y
# BR2_TARGET_ROOTFS_TAR is not set

# Image
BR2_ROOTFS_POST_BUILD_SCRIPT="board/qemu/mac80211_hwsim_demo/post-build.sh"

# Image
BR2_ROOTFS_POST_IMAGE_SCRIPT="board/qemu/post-image.sh"
BR2_ROOTFS_POST_SCRIPT_ARGS="$(BR2_DEFCONFIG)"

# Linux headers same as kernel, a 5.10 series
BR2_PACKAGE_HOST_LINUX_HEADERS_CUSTOM_5_10=y

# Toolchain
# Geoffrey LG: python needs a toolchain with wide chars
BR2_USE_WCHAR=y

# Kernel
BR2_LINUX_KERNEL=y
BR2_LINUX_KERNEL_CUSTOM_VERSION=y
BR2_LINUX_KERNEL_CUSTOM_VERSION_VALUE="5.10.7"
BR2_LINUX_KERNEL_USE_CUSTOM_CONFIG=y
BR2_LINUX_KERNEL_CUSTOM_CONFIG_FILE="board/qemu/mac80211_hwsim_demo/linux.config"

# host-qemu for gitlab testing
BR2_PACKAGE_HOST_QEMU=y
BR2_PACKAGE_HOST_QEMU_SYSTEM_MODE=y

# Add some userspace tooling for demonstration purposes:
#   - hostapd (802.11 access point)
#   - ping (from iputils)
#   - wpa_supplicant (802.11 client)
#   - busybox-provided dhcp client & server
#   - iw (interface configuration for mac80211-friendly devices)
#   - scapy (for packet forging & injection)
BR2_PACKAGE_HOSTAPD=y
BR2_PACKAGE_IPUTILS=y
BR2_PACKAGE_IPUTILS_PING=y
BR2_PACKAGE_WPA_SUPPLICANT=y
BR2_PACKAGE_WPA_SUPPLICANT_NL80211=y
BR2_PACKAGE_BUSYBOX_SHOW_OTHERS=y
BR2_PACKAGE_DHCP=y
BR2_PACKAGE_DHCP_SERVER=y
BR2_PACKAGE_DHCP_CLIENT=y
BR2_PACKAGE_IW=y
BR2_PACKAGE_PYTHON3=y
BR2_PACKAGE_PYTHON_SCAPY=y
# Add some additional packages for going further:
#   - tcpdump (traffic analysis)
#   - trace-cmd (CLI for ftrace => kernel live analysis)
BR2_PACKAGE_TCPDUMP=y
BR2_PACKAGE_TRACE_CMD=y
```
